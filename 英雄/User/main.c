/**********************************************************************************************************
 * @文件     main.c
 * @说明     主文件
 * @版本  	 V1.0
 * @作者     黄沛霖
 * @日期     2019.10
 
 * @文件     main.c
 * @说明     主文件
 * @版本  	 V1.1
 * @作者     刘振武
 * @日期     2020.02
**********************************************************************************************************/
#define MAIN
#include "freertosinc.h"
/**********************************************************************************************************
*函 数 名: main
*功能说明: 主函数
*形    参: 无
*返 回 值: 无
**********************************************************************************************************/
int main()
{
	System_Configration();
	delay_ms(5000);
	System_Init();

	delay_ms(5000);
	startTast();
  vTaskStartScheduler();
	
	while(1){}
} 
/**********************************************************************************************************
*函 数 名: System_Configration
*功能说明: 外设初始化函数
*形    参: 无
*返 回 值: 无
**********************************************************************************************************/
void System_Configration(void)
{
   CAN1_Configration();
	 delay_ms(100);
	 CAN2_Configration();
   delay_ms(100);
	 USART4_Configuration();
	 delay_ms(100);
	 USART1_Configuration();
	 delay_ms(100);
	 IWDG_Config(IWDG_Prescaler_64 ,625);
}

void System_Init(void)
{
   TIM4_Init();
	 RemoteInit(&RC_Ctl);
	 ZeroCheck_Init();
}

/**********************************************************************************************************
*函 数 名: delay_ms
*功能说明: 毫秒延时函数
*形    参: 无
*返 回 值: 无
**********************************************************************************************************/
void delay_ms(unsigned int t)
{
	int i;
	for( i=0;i<t;i++)
	{
		int a=10300;
 		while(a--);
	}
}
